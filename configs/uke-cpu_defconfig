## configs/uke-cpu_defconfig
```kconfig
# uke CPU display baseline: userland boot with the QEMU CPU legacy display.
# No native GPU driver/archive is built; the original QuartzCore CPU renderer
# draws through NativeLegacyDisplay and NativeGOPPresenter.
# This is configs/uke-userland_defconfig plus the owner root, Data, watchdog
# policy and the CPU display.

CONFIG_XNU_BUILD_ARCHIVES=y
CONFIG_XNU_BRINGUP_OWNER_CACHE=y
CONFIG_XNU_SOURCE_CORECRYPTO14=y
CONFIG_XNU_SOURCE_PTHREAD=y
CONFIG_XNU_ARM_DT_PLATFORM=y
CONFIG_XNU_ARMCPU=y
CONFIG_XNU_NATIVE_UFS=y
CONFIG_XNU_NATIVE_AES=y
CONFIG_XNU_TRUST_CACHE_RUNTIME=y
CONFIG_XNU_SOURCE_MOCKFS=y
CONFIG_XNU_NATIVE_CS_HASH_CACHE=y
CONFIG_XNU_SHENG_PMGR=y
CONFIG_XNU_DT_PANIC_REGION=y
CONFIG_XNU_ZONE_PGZ_ALIGNMENT_PROBE=y
CONFIG_XNU_NATIVE_ARCH_TIMER=y
CONFIG_XNU_NATIVE_PAN=y
CONFIG_XNU_NATIVE_LEGACY_DISPLAY=y
# CONFIG_XNU_NATIVE_ADRENO is not set

#
# Hardware-qualification gates, kept for configs/uke-full-plus_defconfig.
#
# CONFIG_XNU_NATIVE_VIRTIO_BLOCK is not set
CONFIG_XNU_NATIVE_RAM_BLOCK=y
# CONFIG_XNU_VERIFIED_ROOT_PROBE is not set
# CONFIG_XNU_OWNER_ROOT_AUDIT is not set
# CONFIG_XNU_OWNER_ROOT_TRUST is not set
CONFIG_XNU_OWNER_CACHE_MOUNT=y
CONFIG_XNU_OWNER_CACHE_STARTUP=y
# CONFIG_XNU_OWNER_BOOT_MANIFEST is not set
CONFIG_XNU_OWNER_DATA_MOUNT=y
CONFIG_XNU_OWNER_UNION_SYSTEMOS=y
# CONFIG_XNU_BOOT_PROGRESS is not set
CONFIG_XNU_BOOT_LOG=y
CONFIG_XNU_WATCHDOG_POLICY=y

CONFIG_XNU_CRYPTO_BOOTSTRAP="prelinked"
CONFIG_XNU_OWNER_DATA_VOLUME_UUID="292E72B9-7594-431D-ADBC-2D354CC918DD"
CONFIG_XNU_EXTRA_LD_ARCHIVES=""
CONFIG_XNU_NATIVE_MOBILE_DISPLAY=n
CONFIG_XNU_ARMVIRT_PLATFORM=n
```
